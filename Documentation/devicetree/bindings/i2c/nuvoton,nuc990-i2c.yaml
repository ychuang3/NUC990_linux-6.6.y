## Documentation/devicetree/bindings/i2c/nuvoton,nuc990-i2c.yaml
```yaml
# SPDX-License-Identifier: (GPL-2.0-only OR BSD-2-Clause)
%YAML 1.2
---
$id: http://devicetree.org/schemas/i2c/busses/nuvoton,nuc990-i2c.yaml#
$schema: http://devicetree.org/meta-schemas/core.yaml#

title: Nuvoton NUC990 I2C Controller

maintainers:
  - ZY Chen <zychen@nuvoton.com>

description: |
  The Nuvoton NUC990 I2C controller supports master mode and optional
  slave mode operation. The controller is configured via Device Tree
  and supports interrupt-driven I2C transfers.

allOf:
  - $ref: /schemas/i2c/i2c-controller.yaml#

properties:
  compatible:
    const: nuvoton,nuc990-i2c

  reg:
    maxItems: 1
    description:
      Base address and size of the I2C controller register space.

  interrupts:
    maxItems: 1
    description:
      Interrupt line for the I2C controller.

  clocks:
    maxItems: 1
    description:
      Input clock for the I2C controller.

  clock-frequency:
    $ref: /schemas/types.yaml#/definitions/uint32
    description:
      Desired I2C bus clock frequency in Hz.
      If omitted, the controller defaults to a hardware-defined
      standard speed.

  resets:
    maxItems: 1
    description:
      Reset control for the I2C controller.

required:
  - compatible
  - reg
  - interrupts
  - clocks

unevaluatedProperties: false

examples:
  - |
    i2c0: i2c@b0080000 {
        compatible = "nuvoton,nuc990-i2c";
        reg = <0xb0080000 0x1000>;
        interrupts = <24 IRQ_TYPE_LEVEL_HIGH>;
        clocks = <&clk I2C0_GATE>;
        resets = <&reset NUC990_RESET_I2C0>;
        clock-frequency = <100000>;
        #address-cells = <1>;
        #size-cells = <0>;
    };
```

## Documentation/devicetree/bindings/iio/adc/nuvoton,nuc990-adc.yaml
```yaml
# SPDX-License-Identifier: (GPL-2.0-only OR BSD-2-Clause)
%YAML 1.2
---
$id: "http://devicetree.org/schemas/iio/adc/nuvoton,nuc990-adc.yaml#"
$schema: "http://devicetree.org/meta-schemas/core.yaml#"

title: Nuvoton NUC990 ADC Controller

maintainers:
  - name: Joey Lu
    email: yclu4@nuvoton.com

description: |
  ADC controller for Nuvoton NUC990 platforms. This binding describes the
  stand-alone ADC peripheral (non-touchscreen mode).

properties:
  compatible:
    const: nuvoton,nuc990-adc

  reg:
    maxItems: 1

  interrupts:
    maxItems: 1

  clocks:
    maxItems: 1

  nuvoton,adc-vref:
    description: ADC reference voltage in millivolts.
    $ref: /schemas/types.yaml#/definitions/uint32
    minimum: 1000
    maximum: 3300
    required: true

  "#io-channel-cells":
    description: Must be 1. Channel index.
    const: 1

required:
  - compatible
  - reg
  - interrupts
  - clocks
  - nuvoton,adc-vref
  - "#io-channel-cells"

additionalProperties: false

examples:
  - |
    adc0: adc@b0043000 {
        compatible = "nuvoton,nuc990-adc";
        reg = <0xb0043000 0x1000>;
        interrupts = <42 IRQ_TYPE_LEVEL_HIGH>;
        clocks = <&clk ADC0_GATE>;
        nuvoton,adc-vref = <3300>;
        #io-channel-cells = <1>;
        status = "okay";
    };
```

## Documentation/devicetree/bindings/iio/adc/nuvoton,nuc990-eadc.yaml
```yaml
# SPDX-License-Identifier: (GPL-2.0-only OR BSD-2-Clause)
%YAML 1.2
---
$id: http://devicetree.org/schemas/iio/adc/nuvoton,nuc990-eadc.yaml#
$schema: http://devicetree.org/meta-schemas/core.yaml#

title: Nuvoton NUC990 Enhanced ADC (EADC)

maintainers:
  - name: Nuvoton Technology Corp.

description: |
  The NUC990 Enhanced ADC (EADC) is a multi-channel ADC controller
  supporting up to 8 single-ended input channels and optional
  differential channel pairs. It supports software-triggered and
  interrupt-triggered conversions and integrates with the Linux
  Industrial I/O (IIO) framework.

properties:
  compatible:
    const: nuvoton,nuc990-eadc

  reg:
    maxItems: 1
    description:
      Base address and size of the EADC register block.

  interrupts:
    minItems: 1
    maxItems: 4
    description:
      EADC interrupt lines. The first interrupt is used for ADINT0.
      Additional interrupts may be present for future extensions.

  clocks:
    maxItems: 1
    description:
      Gate clock for the EADC controller.

  clock-names:
    items:
      - const: eadc0_gate

  clock-enable:
    description:
      Name of the EADC clock gate. This property is used by the driver
      to identify which clock should be enabled.
    $ref: /schemas/types.yaml#/definitions/string

  nuvoton,sys:
    description:
      Phandle to the system controller (syscon) node used to enable
      the EADC function via SYS_MISCFCR.
    $ref: /schemas/types.yaml#/definitions/phandle

  eadc-frequency:
    description:
      Desired EADC operating clock frequency in Hz.
    $ref: /schemas/types.yaml#/definitions/uint32
    minimum: 1

  eadc-channels:
    description: |
      List of single-ended ADC channels to enable.
      Each value represents a channel index.
    $ref: /schemas/types.yaml#/definitions/uint32-array
    minItems: 1
    maxItems: 8
    items:
      minimum: 0
      maximum: 7

  eadc-diff-channels:
    description: |
      List of differential ADC channel pairs.
      Each pair consists of two values: <vinp vinn>.
    $ref: /schemas/types.yaml#/definitions/uint32-array
    minItems: 2
    maxItems: 16
    items:
      minimum: 0
      maximum: 7

  "#io-channel-cells":
    const: 1

required:
  - compatible
  - reg
  - interrupts
  - clocks
  - clock-names
  - nuvoton,sys
  - eadc-frequency

additionalProperties: false

examples:
  - |
    eadc0: eadc@b0044000 {
        compatible = "nuvoton,nuc990-eadc";
        reg = <0xb0044000 0x1000>;
        interrupts = <43 IRQ_TYPE_LEVEL_HIGH>;
        clocks = <&clk EADC0_GATE>;
        clock-names = "eadc0_gate";
        clock-enable = "eadc0_gate";
        nuvoton,sys = <&sys>;
        eadc-frequency = <10000000>;
        eadc-channels = <0 1 2 3 4 5 6 7>;
        #io-channel-cells = <1>;
        status = "okay";
    };
```

## Documentation/devicetree/bindings/input/touchscreen/nuvoton,nuc990-ts.yaml
```yaml
# SPDX-License-Identifier: (GPL-2.0-only OR BSD-2-Clause)
%YAML 1.2
---
$id: "http://devicetree.org/schemas/input/touchscreen/nuvoton,nuc990-ts.yaml#"
$schema: "http://devicetree.org/meta-schemas/core.yaml#"

title: Nuvoton NUC990 Touchscreen Controller

maintainers:
  - name: Joey Lu
    email: yclu4@nuvoton.com

description: |
  Touchscreen controller integrated in the Nuvoton NUC990 SoC. This mode
  reuses the ADC hardware block with touchscreen-specific settings.

properties:
  compatible:
    const: nuvoton,nuc990-ts

  reg:
    maxItems: 1

  interrupts:
    maxItems: 1

  clocks:
    maxItems: 1

  enable-iio:
    type: boolean
    description: Enable IIO interface for dual-mode support.

  enable-ts:
    type: boolean
    description: Enable touchscreen mode.

  ts-type:
    description: |
      Touchscreen type.
      Allowed values:
        4 = 4-wire resistive
        5 = 5-wire resistive
    enum: [4, 5]

required:
  - compatible
  - reg
  - interrupts
  - clocks

additionalProperties: false

examples:
  - |
    ts0: touchscreen@b0043000 {
        compatible = "nuvoton,nuc990-ts";
        reg = <0xb0043000 0x1000>;
        interrupts = <42 IRQ_TYPE_LEVEL_HIGH>;
        clocks = <&clk ADC0_GATE>;
        enable-iio;
        enable-ts;
        ts-type = <4>;
        status = "okay";
    };
```

## Documentation/devicetree/bindings/misc/nuvoton,nuc990-ebi.yaml
```yaml
# SPDX-License-Identifier: (GPL-2.0-only OR BSD-2-Clause)
%YAML 1.2
---
$id: "http://devicetree.org/schemas/misc/nuvoton,nuc990-timer.yaml#"
$schema: "http://devicetree.org/meta-schemas/core.yaml#"

title: Nuvoton NUC990 External Bus Interface(EBI) Controller

maintainers:
  - ZY Chen <zychen@nuvoton.com>

description: |
  This chip is equipped with an external bus interface for external device 
  use. The EBI supports three chip selects that can connect three external 
  devices with different timing setting requirements.

properties:
  compatible:
    const: nuvoton,nuc990-ebi

  reg:
    maxItems: 1

  clocks:
    maxItems: 1

  clock-names:
    items:
      - const: ebi_gate

  bank:
    description: EBI chip-select bank index.
    $ref: /schemas/types.yaml#/definitions/uint32
    minimum: 0
    maximum: 2

  csactiveLevel:
    description: |
      Chip-select active level.
      0 = active low, 1 = active high.
    $ref: /schemas/types.yaml#/definitions/uint32
    enum: [0, 1]

  datawidth:
    description: |
      External bus data width.
      0 = 8-bit, 1 = 16-bit.
    $ref: /schemas/types.yaml#/definitions/uint32
    enum: [0, 1]

  MCLKDIV:
    description: |
      EBI master clock divider value.
      Maps to EBI_CTL[10:8].
    $ref: /schemas/types.yaml#/definitions/uint32
    minimum: 0
    maximum: 7

  tACC:
    description: |
      Access time setting.
      Maps to EBI_TCTL[7:3].
    $ref: /schemas/types.yaml#/definitions/uint32
    minimum: 0
    maximum: 31

  tAHD:
    description: |
      Address hold time.
      Maps to EBI_TCTL[10:9].
    $ref: /schemas/types.yaml#/definitions/uint32
    minimum: 0
    maximum: 7

  IDLE:
    description: |
      Bus idle cycle configuration.
      Maps to EBI_TCTL[27:24] and EBI_TCTL[15:12].
    $ref: /schemas/types.yaml#/definitions/uint32
    minimum: 0
    maximum: 15

required:
  - compatible
  - reg
  - clocks
  - clock-names
  - bank
  - csactiveLevel
  - datawidth
  - MCLKDIV
  - tACC
  - tAHD
  - IDLE

additionalProperties: false

examples:
  - |
    ebi0: ebi@b0010000 {
        compatible = "nuvoton,nuc990-ebi";
        reg = <0xb0010000 0x10>;
        clocks = <&clk EBI_GATE>;
        clock-names = "ebi_gate";
        bank = <0>;
        csactiveLevel = <0>;
        datawidth = <1>;
        MCLKDIV = <2>;
        tACC = <1>;
        tAHD = <1>;
        IDLE = <3>;
    };
```

## Documentation/devicetree/bindings/misc/nuvoton,nuc990-keystore.yaml
```yaml
# SPDX-License-Identifier: (GPL-2.0-only OR BSD-2-Clause)
%YAML 1.2
---
$id: "http://devicetree.org/schemas/misc/nuvoton,nuc990-keystore.yaml#"
$schema: "http://devicetree.org/meta-schemas/core.yaml#"

title: Nuvoton NUC990 Key Store Controller

maintainers:
  - Jacky Huang <jacky.huang@nuvoton.com>

description: |
  Key Store controller in the Nuvoton NUC990 series SoCs.
  This block provides simple SRAM/OTP key storage access via
  register read/write operations.

properties:
  compatible:
    const: nuvoton,nuc990-keystore

  reg:
    maxItems: 1
    description:
      Base address and size of the hardware register block.

  clocks:
    maxItems: 1

  clock-names:
    items:
      - const: ks_gate

  interrupts:
    maxItems: 1
    description:
      Optional interrupt for event/error notification.

required:
  - compatible
  - reg
  - clocks
  - clock-names

additionalProperties: false

examples:
  - |
    keystore@b001f000 {
        compatible = "nuvoton,nuc990-keystore";
        reg = <0xb001f000 0x50>;
        clocks = <&clk KS_GATE>;
        clock-names = "ks_gate";
        status = "okay";
    };
```

## Documentation/devicetree/bindings/misc/nuvoton,nuc990-timer.yaml
```yaml
# SPDX-License-Identifier: (GPL-2.0-only OR BSD-2-Clause)
%YAML 1.2
---
$id: "http://devicetree.org/schemas/misc/nuvoton,nuc990-timer.yaml#"
$schema: "http://devicetree.org/meta-schemas/core.yaml#"

title: Nuvoton NUC990 Timer Controller

maintainers:
  - ZY Chen <zychen@nuvoton.com>

description: |
  General-purpose timer controller for Nuvoton NUC990 platforms.

properties:
  compatible:
    const: nuvoton,nuc990-timer

  reg:
    maxItems: 1

  interrupts:
    maxItems: 1

  clocks:
    maxItems: 1

  assigned-clocks:
    maxItems: 1

  port-number:
    description: Timer channel index.
    $ref: /schemas/types.yaml#/definitions/uint32
    minimum: 0
    maximum: 3
    required: true

required:
  - compatible
  - reg
  - interrupts
  - clocks
  - port-number

additionalProperties: false

examples:
  # timer control module node:
  - |
    timer0: timer@b0050000 {
        compatible = "nuvoton,nuc990-timer";
        reg = <0xb0050000 0x100>;
        interrupts = <18 IRQ_TYPE_LEVEL_HIGH>;
        clocks = <&clk TMR0_GATE>;
        port-number = <0>;
    };
```

## Documentation/devicetree/bindings/net/can/nuvoton,nuc990-can.yaml
```yaml
# SPDX-License-Identifier: (GPL-2.0-only OR BSD-2-Clause)
%YAML 1.2
---
$id: "http://devicetree.org/schemas/net/can/nuvoton,nuc990-can.yaml#"
$schema: "http://devicetree.org/meta-schemas/core.yaml#"

title: Nuvoton NUC990 Controller Area Network (CAN2.0) Controller

maintainers:
  - ZY Chen <zychen@nuvoton.com>

description: |
  NUVOTON NUC990 Controller Area Network (CAN 2.0) controller.
  This binding describes the device tree properties required to
  use "nuvoton,nuc990-can0" in a Linux system.

properties:
  compatible:
    const: nuvoton,nuc990-can

  reg:
    description: Register block addresses
    type: phandle

  interrupts:
    description: Interrupts used by the CAN controller
    type: phandle-array

  clocks:
    description: The CAN controller clock(s) required by the device
    type: phandle-array

  wakeup-source:
    type: boolean
    description:
      Indicates that the CAN controller can wake up the system from suspend.

required:
  - compatible
  - reg
  - interrupts

additionalProperties: false

examples:
  - |
    can0: can@b00a0000 {
      compatible = "nuvoton,nuc990-can";
      reg = <0xb00a0000 0x1000>;
      interrupts = <64 IRQ_TYPE_LEVEL_HIGH>;
      clocks = <&clk CAN0_GATE>;
      wakeup-source;
    };
```

## Documentation/devicetree/bindings/rtc/nuvoton,nuc990-rtc.yaml
```yaml
# SPDX-License-Identifier: (GPL-2.0-only OR BSD-2-Clause)
%YAML 1.2
---
$id: http://devicetree.org/schemas/rtc/nuvoton,nuc990-rtc.yaml#
$schema: http://devicetree.org/meta-schemas/core.yaml#

title: Nuvoton NUC990 Real Time Clock (RTC)

maintainers:
  - name: Nuvoton Technology Corporation
    email: linux-kernel@nuvoton.com

description: |
  The Nuvoton NUC990 RTC provides real-time clock and alarm functionality.
  It supports:
    - Time and calendar registers in BCD format
    - Alarm interrupt
    - Periodic tick interrupt
  The RTC is accessed via a memory-mapped register interface and requires
  a dedicated RTC gate clock.

properties:
  compatible:
    const: nuvoton,nuc990-rtc

  reg:
    maxItems: 1
    description:
      Base address and size of the RTC register block.

  interrupts:
    maxItems: 1
    description:
      RTC interrupt for alarm and periodic tick events.

  clocks:
    maxItems: 1
    description:
      RTC functional clock.

  clock-names:
    items:
      - const: rtc_gate

  nuvoton,sys:
    $ref: /schemas/types.yaml#/definitions/phandle
    description:
      Phandle to the NUC990 system controller (syscon).

  status:
    enum:
      - okay
      - disabled

required:
  - compatible
  - reg
  - interrupts
  - clocks
  - clock-names

additionalProperties: false

examples:
  - |
    apb {
        rtc: rtc@b0041000 {
            compatible = "nuvoton,nuc990-rtc";
            reg = <0xb0041000 0x1000>;
            interrupts = <17 IRQ_TYPE_LEVEL_HIGH>;
            clocks = <&clk RTC_GATE>;
            clock-names = "rtc_gate";
            nuvoton,sys = <&sys>;
            status = "okay";
        };
    };
...
```
