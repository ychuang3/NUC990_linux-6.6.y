## Documentation/devicetree/bindings/sound/nuvoton,nuc990-i2s.yaml
```yaml
# SPDX-License-Identifier: (GPL-2.0-only OR BSD-2-Clause)
%YAML 1.2
---
$id: http://devicetree.org/schemas/sound/nuvoton,nuc990-i2s.yaml#
$schema: http://devicetree.org/meta-schemas/core.yaml#

title: Nuvoton NUC990 I2S Controller

maintainers:
  - ZY Chen <zychen@nuvoton.com>

description: |
  The I2S block supports I2S protocol when configured in
  I2S mode. It can operate as master or slave and supports
  standard audio formats with configurable sample rates.

allOf:
  - $ref: dai-common.yaml#

properties:
  compatible:
    const: nuvoton,nuc990-audio-i2s

  reg:
    maxItems: 1
    description:
      Base address and size of the I2S controller register space.

  interrupts:
    maxItems: 1
    description:
      Interrupt line for the I2S controller.

  clocks:
    maxItems: 1
    description:
      Input clocks for the I2S controller.
      Typically one for peripheral clock, optionally one for audio master clock.

  clock-names:
    type: array
    items:
      type: string
    description:
      Names corresponding to each clock in 'clocks' property.

  resets:
    maxItems: 1
    description: Reset control for the I2S controller.

required:
  - compatible
  - reg
  - interrupts
  - clocks

unevaluatedProperties: false

examples:
  - |
    i2s: i2s@b0020000 {
      compatible = "nuvoton,nuc990-audio-i2s";
      reg = <0xb0020000 0x1000>;
      interrupts = <16 IRQ_TYPE_LEVEL_HIGH>;
      clocks = <&clk I2S_GATE>;
      resets = <&reset NUC990_RESET_I2S>;
    };
```

## Documentation/devicetree/bindings/spi/nuvoton,nuc990-qspi.yaml
```yaml
# SPDX-License-Identifier: (GPL-2.0-only OR BSD-2-Clause)
%YAML 1.2
---
$id: "http://devicetree.org/schemas/spi/nuvoton,nuc990-qspi.yaml#"
$schema: "http://devicetree.org/meta-schemas/core.yaml#"

title: Nuvoton NUC990 Quad SPI (QSPI) Controller

maintainers:
  - name: Chi-Wen Weng
    email: cwweng@nuvoton.com

description: |
  The Nuvoton NUC990 QSPI controller supports single, dual and quad SPI
  transfer modes and can be used to interface with SPI NOR or SPI NAND
  flash devices as well as generic SPI peripherals.

  The controller supports up to two chip selects and integrates with
  the Linux SPI controller and SPI-mem frameworks.

allOf:
  - $ref: /schemas/spi/spi-controller.yaml#

properties:
  compatible:
    const: nuvoton,nuc990-qspi

  reg:
    maxItems: 1
    description:
      Base address and size of the QSPI controller registers.

  interrupts:
    maxItems: 1
    description:
      QSPI controller interrupt.

  clocks:
    maxItems: 1
    description:
      QSPI functional clock.

  clock-names:
    items:
      - const: qspi
    description:
      Name of the QSPI clock.

  num-cs:
    $ref: /schemas/types.yaml#/definitions/uint32
    minimum: 1
    maximum: 2
    default: 2
    description:
      Number of supported chip selects.

  lsb:
    $ref: /schemas/types.yaml#/definitions/uint32
    enum: [0, 1]
    default: 0
    description:
      Set to 1 to enable LSB-first transfer.

  sleep:
    $ref: /schemas/types.yaml#/definitions/uint32
    description:
      Sleep cycle configuration for the QSPI controller.

  txbitlen:
    $ref: /schemas/types.yaml#/definitions/uint32
    enum: [8, 16, 32]
    default: 8
    description:
      SPI transfer word length in bits.

  bus-num:
    $ref: /schemas/types.yaml#/definitions/uint32
    description:
      SPI bus number.

  spimode:
    $ref: /schemas/types.yaml#/definitions/uint32
    description:
      Default SPI mode (0-3).

  quad:
    $ref: /schemas/types.yaml#/definitions/uint32
    enum: [0, 1]
    default: 0
    description:
      Enable quad mode capability.

  mrxphase:
    $ref: /schemas/types.yaml#/definitions/uint32
    description:
      MRxPhase configuration for internal QSPI sampling timing.

required:
  - compatible
  - reg
  - interrupts
  - clocks

unevaluatedProperties: false

patternProperties:
  "^spi@[0-9a-f]+$":
    $ref: /schemas/spi/spi-device.yaml#

examples:
  - |
    qspi: qspi@b0060000 {
        compatible = "nuvoton,nuc990-qspi";
        reg = <0xb0060000 0x1000>;
        interrupts = <47 IRQ_TYPE_LEVEL_HIGH>;
        clocks = <&clk QSPI0_GATE>;

        num-cs = <2>;
        lsb = <0>;
        sleep = <0>;
        txbitlen = <8>;
        quad = <0>;
        bus-num = <0>;
        spimode = <0>;
        mrxphase = <0>;

        #address-cells = <1>;
        #size-cells = <0>;

        flash@0 {
            compatible = "spi-nand";
            reg = <0>;
            spi-max-frequency = <30000000>;
        };

        spi@1 {
            compatible = "semtech,sx1301";
            reg = <1>;
            spi-max-frequency = <12000000>;
        };
    };
```

## Documentation/devicetree/bindings/spi/nuvoton,nuc990-spi.yaml
```yaml
# SPDX-License-Identifier: (GPL-2.0-only OR BSD-2-Clause)
%YAML 1.2
---
$id: "http://devicetree.org/schemas/spi/nuvoton,nuc990-spi.yaml#"
$schema: "http://devicetree.org/meta-schemas/core.yaml#"

title: Nuvoton NUC990 SPI Controller

maintainers:
  - name: Chi-Wen Weng
    email: cwweng@nuvoton.com

description: |
  The Nuvoton NUC990 SPI controller supports single, and dual SPI
  transfer modes and can be used to interface with SPI NOR or SPI NAND
  flash devices as well as generic SPI peripherals.

  The controller supports up to two chip selects and integrates with
  the Linux SPI controller and SPI-mem frameworks.

allOf:
  - $ref: /schemas/spi/spi-controller.yaml#

properties:
  compatible:
    const: nuvoton,nuc990-spi

  reg:
    maxItems: 1
    description:
      Base address and size of the SPI controller registers.

  interrupts:
    maxItems: 1
    description:
      SPI controller interrupt.

  clocks:
    maxItems: 1
    description:
      SPI functional clock.

  clock-names:
    items:
      - const: spi
    description:
      Name of the SPI clock.

  num-cs:
    $ref: /schemas/types.yaml#/definitions/uint32
    minimum: 1
    maximum: 2
    default: 2
    description:
      Number of supported chip selects.

  lsb:
    $ref: /schemas/types.yaml#/definitions/uint32
    enum: [0, 1]
    default: 0
    description:
      Set to 1 to enable LSB-first transfer.

  sleep:
    $ref: /schemas/types.yaml#/definitions/uint32
    description:
      Sleep cycle configuration for the SPI controller.

  txbitlen:
    $ref: /schemas/types.yaml#/definitions/uint32
    enum: [8, 16, 32]
    default: 8
    description:
      SPI transfer word length in bits.

  bus-num:
    $ref: /schemas/types.yaml#/definitions/uint32
    description:
      SPI bus number.

  spimode:
    $ref: /schemas/types.yaml#/definitions/uint32
    description:
      Default SPI mode (0-3).

  quad:
    $ref: /schemas/types.yaml#/definitions/uint32
    enum: [0, 1]
    default: 0
    description:
      Enable quad mode capability.

  mrxphase:
    $ref: /schemas/types.yaml#/definitions/uint32
    description:
      MRxPhase configuration for internal SPI sampling timing.

required:
  - compatible
  - reg
  - interrupts
  - clocks

unevaluatedProperties: false

patternProperties:
  "^spi@[0-9a-f]+$":
    $ref: /schemas/spi/spi-device.yaml#

examples:
  - |
    spi: spi@b0061000 {
        compatible = "nuvoton,nuc990-spi";
        reg = <0xb0060000 0x1000>;
        interrupts = <48 IRQ_TYPE_LEVEL_HIGH>;
        clocks = <&clk SPI0_GATE>;

        num-cs = <2>;
        lsb = <0>;
        sleep = <0>;
        txbitlen = <8>;
        bus-num = <0>;
        spimode = <0>;
        mrxphase = <0>;

        #address-cells = <1>;
        #size-cells = <0>;

        flash@0 {
            compatible = "spi-nand";
            reg = <0>;
            spi-max-frequency = <30000000>;
        };

        spi@1 {
            compatible = "semtech,sx1301";
            reg = <1>;
            spi-max-frequency = <12000000>;
        };
    };
```

## Documentation/devicetree/bindings/usb/nuvoton,nuc990-ehci.yaml
```yaml
# SPDX-License-Identifier: (GPL-2.0-only OR BSD-2-Clause)
%YAML 1.2
---
$id: "http://devicetree.org/schemas/usb/nuvoton,nuc990-ehci.yaml#"
$schema: "http://devicetree.org/meta-schemas/core.yaml#"

title: Nuvoton NUC990 EHCI Host Controller

maintainers:
  - Jacky Huang <your_email@nuvoton.com>

properties:
  compatible:
    const: nuvoton,nuc990-ehci

  reg:
    maxItems: 1

  interrupts:
    maxItems: 1

  clocks:
    maxItems: 1
    description: Handle to USB Host clock.

  clock-names:
    items:
      - const: usbh_gate

  nuvoton,sys:
    $ref: /schemas/types.yaml#/$defs/phandle
    description: Phandle to NUC990 SYS controller for USBID / USRHDSEN configuration.

  nuvoton,ohci:
    $ref: /schemas/types.yaml#/$defs/phandle
    description: Phandle to companion OHCI controller.

  oc-active-level:
    description: Overcurrent active level. 0 = active-low, 1 = active-high.
    $ref: /schemas/types.yaml#/definitions/uint32

required:
  - compatible
  - reg
  - interrupts
  - clocks
  - clock-names
  - nuvoton,sys
  - nuvoton,ohci

additionalProperties: false

examples:
  - |
    sys: syscon@b0000000 {
        compatible = "nuvoton,nuc990-syscon", "syscon", "simple-mfd";
        reg = <0xb0000000 0x200>;
    };

    ohci: ohci@b0014000 {
        compatible = "nuvoton,nuc990-ohci";
        reg = <0xb0014000 0x1000>;
        interrupts = <53>;
        clocks = <&clk USBH_GATE>;
    };

    ehci@b0015000 {
        compatible = "nuvoton,nuc990-ehci";
        reg = <0xb0015000 0x1000>;
        interrupts = <54>;
        clocks = <&clk USBH_GATE>;
        clock-names = "usbh_gate";
        nuvoton,sys = <&sys>;
        nuvoton,ohci = <&ohci>;
        oc-active-level = <1>;
    };
```

## Documentation/devicetree/bindings/usb/nuvoton,nuc990-ohci.yaml
```yaml
# SPDX-License-Identifier: (GPL-2.0-only OR BSD-2-Clause)
%YAML 1.2
---
$id: "http://devicetree.org/schemas/usb/nuvoton,nuc990-ohci.yaml#"
$schema: "http://devicetree.org/meta-schemas/core.yaml#"

title: Nuvoton NUC990 OHCI Host Controller

maintainers:
  - Jacky Huang <your_email@nuvoton.com>

properties:
  compatible:
    const: nuvoton,nuc990-ohci

  reg:
    maxItems: 1

  interrupts:
    maxItems: 1

  clocks:
    maxItems: 1
    description: Handle to USB Host clock.

required:
  - compatible
  - reg
  - interrupts
  - clocks

additionalProperties: false

examples:
  - |
    ohci@b0014000 {
        compatible = "nuvoton,nuc990-ohci";
        reg = <0xb0014000 0x1000>;
        interrupts = <53>;
        clocks = <&clk USBH_GATE>;
    };
```

## Documentation/devicetree/bindings/watchdog/nuvoton,nuc990-wdt.yaml
```yaml
# SPDX-License-Identifier: (GPL-2.0-only OR BSD-2-Clause)
%YAML 1.2
---
$id: "http://devicetree.org/schemas/watchdog/nuvoton,nuc990-wdt.yaml#"
$schema: "http://devicetree.org/meta-schemas/core.yaml#"

title: Nuvoton NUC990 Watchdog Timer

maintainers:
  - name: Nuvoton MPU Software Team
    email: linux-arm@lists.infradead.org

description: |
  The Nuvoton NUC990 Watchdog Timer (WDT) provides a hardware watchdog
  that can reset the system when software becomes unresponsive.
  The watchdog clock source is configured via the clock controller
  using assigned-clocks.

properties:
  compatible:
    const: nuvoton,nuc990-wdt

  reg:
    maxItems: 1
    description: Base address and size of the watchdog registers.

  interrupts:
    maxItems: 1
    description: Watchdog interrupt line, used when wakeup support is enabled.

  clocks:
    minItems: 1
    maxItems: 1
    description: |
      The gated watchdog clock. The watchdog driver consumes this clock
      and enables or disables it at runtime.

  clock-names:
    items:
      - const: wdt0_gate

  assigned-clocks:
    minItems: 1
    maxItems: 1
    description: |
      Clock mux used to select the watchdog clock source. This is typically
      the parent of the watchdog gated clock.

  assigned-clock-parents:
    minItems: 1
    maxItems: 1
    description: |
      Parent clock used as the watchdog clock source.

  nuvoton,sys:
    $ref: /schemas/types.yaml#/definitions/phandle
    description: |
      Phandle to the system controller node. This is required to access
      the global write-protect and reset control registers.

  nuvoton,wdt-wakeup:
    type: boolean
    description: |
      Enable watchdog interrupt and system wakeup support.

  status:
    enum:
      - okay
      - disabled

required:
  - compatible
  - reg
  - clocks
  - clock-names
  - nuvoton,sys

additionalProperties: false

examples:
  - |
    wdt0: wdt@b0040000 {
        compatible = "nuvoton,nuc990-wdt";
        reg = <0xb0040000 0x100>;
        interrupts = <1 IRQ_TYPE_LEVEL_HIGH>;

        clocks = <&clk WDT0_GATE>;
        clock-names = "wdt0_gate";

        assigned-clocks = <&clk WDT0_MUX>;
        assigned-clock-parents = <&clk HXT_DIV512>;

        nuvoton,sys = <&sys>;
        nuvoton,wdt-wakeup;

        status = "okay";
    };
```

## Documentation/devicetree/bindings/watchdog/nuvoton,nuc990-wwdt.yaml
```yaml
# SPDX-License-Identifier: (GPL-2.0-only OR BSD-2-Clause)
%YAML 1.2
---
$id: http://devicetree.org/schemas/watchdog/nuvoton,nuc990-wwdt.yaml#
$schema: http://devicetree.org/meta-schemas/core.yaml#

title: Nuvoton NUC990 Window Watchdog Timer (WWDT)

maintainers:
  - name: Nuvoton MPU Software Team
    email: linux@nuvoton.com

description: |
  The Nuvoton NUC990 Window Watchdog Timer (WWDT) is a hardware watchdog
  that requires periodic reloads within a defined time window.
  Once started, the watchdog cannot be stopped ("no way out") and will
  reset the system if the reload operation is not performed correctly.

  The watchdog clock source is configured via the clock framework and
  is expected to be fixed by the device tree. The driver uses a fixed
  hardware configuration and exposes a nominal timeout.

properties:
  compatible:
    const: nuvoton,nuc990-wwdt

  reg:
    maxItems: 1
    description:
      Base address and size of the WWDT register region.

  clocks:
    maxItems: 1
    description:
      Gate clock for the WWDT peripheral.

  clock-names:
    items:
      - const: wwdt0_gate

  assigned-clocks:
    maxItems: 1
    description:
      Clock mux used to select the WWDT clock source.

  assigned-clock-parents:
    maxItems: 1
    description:
      Parent clock for the WWDT clock mux. This should be configured to
      a stable low-frequency clock suitable for watchdog operation.

  nuvoton,sys:
    $ref: /schemas/types.yaml#/definitions/phandle
    description:
      Phandle to the NUC990 system controller registers, used to control
      the write-protection mechanism required to configure the WWDT.

  status:
    enum:
      - okay
      - disabled

required:
  - compatible
  - reg
  - clocks
  - clock-names
  - nuvoton,sys

additionalProperties: false

examples:
  - |
    wwdt0: wwdt@b0040100 {
        compatible = "nuvoton,nuc990-wwdt";
        reg = <0xb0040100 0x100>;
        clocks = <&clk WWDT0_GATE>;
        clock-names = "wwdt0_gate";
        assigned-clocks = <&clk WWDT0_MUX>;
        assigned-clock-parents = <&clk HXT_DIV512>;
        nuvoton,sys = <&sys>;
        status = "okay";
    };
...
```
